OUTPUT_FORMAT("binary")
ENTRY(my_driver)

SECTIONS
{
    /* * Базовый адрес устанавливаем в 0x0.
     * Драйвер не знает, куда именно ядро загрузит его в оперативку,
     * поэтому все внутренние указатели компилируются относительно нуля.
     */
    . = 0x0;

    .text : {
        *(.header)      /* Сначала принудительно кладем секцию с заголовком */
        *(.text)        /* Затем идет весь исполняемый Си-код драйвера */
        *(.text.*)
    }

    .rodata : {
        *(.rodata)      /* Строковые константы и read-only данные */
        *(.rodata.*)
    }

    .data : {
        *(.data)        /* Глобальные инициализированные переменные */
        *(.data.*)
    }

    .bss : {
        *(.bss)         /* Неинициализированные переменные */
        *(.bss.*)
        *(COMMON)
    }

    /* Выкидываем ненужные секции метаданных компилятора, чтобы уменьшить размер */
    /DISCARD/ : {
        *(.comment) 
        *(.eh_frame)
        *(.note.*)
    }
}